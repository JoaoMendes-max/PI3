## CMakeLists.txt
```
cmake_minimum_required(VERSION 3.20.0)
find_package(Zephyr REQUIRED HINTS $ENV{ZEPHYR_BASE})
project(demos_seguranca)
target_sources(app PRIVATE src/main_z_attack3_global.c)
```

## prj.conf
```kconfig
CONFIG_USERSPACE=y

CONFIG_PRINTK=y
CONFIG_SYS_CLOCK_HW_CYCLES_PER_SEC=10000
CONFIG_SYS_CLOCK_TICKS_PER_SEC=1000
# CVA6 TOR+Lock bloqueia M-mode reads mesmo com R bit activo -- remover L da ROM
CONFIG_PMP_UNLOCK_ROM_FOR_DEBUG=y
```

## src/demo_fpga_pwm.c
```c
//
// Created by mendes on 11/06/26.
//

#include <zephyr/kernel.h>
#include <zephyr/sys/printk.h>
#include <zephyr/app_memory/app_memdomain.h>
#include <zephyr/sys/libc-hooks.h>

/* ── Hardware ─────────────────────────────────────── */
#define GPIO_BASE_ADDR  0x40000000

typedef struct {
    volatile uint32_t GPIO_DATA;
    volatile uint32_t GPIO_TRI;
    volatile uint32_t GPIO2_DATA;
    volatile uint32_t GPIO2_TRI;
} AXI_GPIO_t;

#define GPIO ((AXI_GPIO_t *) GPIO_BASE_ADDR)


#define PIN_IN1  (1 << 3)   /* JD1 */
#define PIN_IN2  (1 << 4)   /* JD2 */

#define MOTOR_FWD  (PIN_IN1)   /* IN1=1, IN2=0 → frente */
#define MOTOR_OFF  (0)         /* IN1=0, IN2=0 → parado */

#define PWM_PERIOD_MS  10


#define SW0  (1 << 4)

/* ── Shared Memory ────────────────────────────────── */
#define STACKSIZE 2048
#define PRIORITY  7

K_APPMEM_PARTITION_DEFINE(shared_part);

K_APP_DMEM(shared_part) volatile uint32_t leaked_addr = 0;
K_APP_DMEM(shared_part) volatile uint32_t shared_ready = 0;

/* ── Memory Domains ───────────────────────────────── */
K_MEM_PARTITION_DEFINE(gpio_partition,
    GPIO_BASE_ADDR,
    0x1000,
    K_MEM_PARTITION_P_RW_U_RW);

static struct k_mem_domain domMotor;
static struct k_mem_domain domAdv;

/* ── Thread objects ───────────────────────────────── */
struct k_thread task_motor_thread;
K_THREAD_STACK_DEFINE(task_motor_stack, STACKSIZE);

struct k_thread task_adv_thread;
K_THREAD_STACK_DEFINE(task_adv_stack, STACKSIZE);

/* ── Task Motor ───────────────────────────────────── */
void task_motor_entry(void *p1, void *p2, void *p3)
{
    printk("[MOTOR] a correr\n");

    volatile uint32_t pwm_duty = 70;

    leaked_addr = (uint32_t)&pwm_duty;
    shared_ready = 1;
    printk("[MOTOR] pwm_duty em stack: 0x%08x\n", (uint32_t)&pwm_duty);

    GPIO->GPIO_TRI = 0x00;  /* canal 1 todo output */

    while (1) {
        uint32_t on_ms  = (pwm_duty * PWM_PERIOD_MS) / 100;
        uint32_t off_ms = PWM_PERIOD_MS - on_ms;

        GPIO->GPIO_DATA = MOTOR_FWD;
        if (on_ms > 0)  k_sleep(K_MSEC(on_ms));

        GPIO->GPIO_DATA = MOTOR_OFF;
        if (off_ms > 0) k_sleep(K_MSEC(off_ms));

        if (pwm_duty == 30)
            printk("[MOTOR] pwm_duty CORROMPIDO — motor a abrandar!\n");
    }
}

/* ── Task Adversarial ─────────────────────────────── */
void task_adv_entry(void *p1, void *p2, void *p3)
{
    printk("[ADV] a aguardar SW0...\n");

    while (shared_ready == 0) {
        k_sleep(K_MSEC(100));
    }

    /* espera SW0 */
    while (!(GPIO->GPIO2_DATA & SW0)) {
        k_sleep(K_MSEC(100));
    }

    volatile uint32_t *ptr = (volatile uint32_t *)leaked_addr;

    printk("[ADV] SW0 ativo! endereco lido: 0x%08x\n", (uint32_t)ptr);
    printk("[ADV] a tentar corromper pwm_duty...\n");

    *ptr = 30;  /* Zephyr → Store Access Fault | FreeRTOS → motor abranda */

    printk("[ADV] pwm_duty corrompido — motor a abrandar!\n");  /* nunca executa no Zephyr */
}

/* ── Main ─────────────────────────────────────────── */
int main(void)
{
    k_tid_t tMotor, tAdv;

    printk("[MAIN] a configurar dominios...\n");

    tMotor = k_thread_create(&task_motor_thread, task_motor_stack, STACKSIZE,
                             task_motor_entry, NULL, NULL, NULL,
                             PRIORITY, K_USER, K_FOREVER);

    tAdv = k_thread_create(&task_adv_thread, task_adv_stack, STACKSIZE,
                           task_adv_entry, NULL, NULL, NULL,
                           PRIORITY, K_USER, K_FOREVER);

    struct k_mem_partition *parts_motor[] = {
#if Z_LIBC_PARTITION_EXISTS
        &z_libc_partition,
#endif
        &shared_part,
        &gpio_partition
    };

    struct k_mem_partition *parts_adv[] = {
#if Z_LIBC_PARTITION_EXISTS
        &z_libc_partition,
#endif
        &shared_part,
        &gpio_partition
    };

    k_mem_domain_init(&domMotor, ARRAY_SIZE(parts_motor), parts_motor);
    k_mem_domain_add_thread(&domMotor, tMotor);
    printk("[MAIN] domMotor configurado\n");

    k_mem_domain_init(&domAdv, ARRAY_SIZE(parts_adv), parts_adv);
    k_mem_domain_add_thread(&domAdv, tAdv);
    printk("[MAIN] domAdv configurado\n");

    k_thread_start(tMotor);
    k_thread_start(tAdv);

    printk("[MAIN] threads arrancadas\n");
    return 0;
}
```

## src/main_z_attack1_hijack.c
```c
#include <zephyr/kernel.h>
#include <zephyr/sys/printk.h>

/* FreeRTOS: ambas as tasks em M-mode, adversarial escreve na flag global e chama funcao da TaskA
   Zephyr:   ambas as tasks em U-mode, adversarial tenta escrever na flag -> Store Access Fault */

#define STACKSIZE 4096
#define PRIORITY  7

static volatile int chamado_por_adversarial = 0;

void task_a_entry(void *p1, void *p2, void *p3)
{
    for (;;) {
        printk("[TASK A] a correr normalmente\n");
        k_sleep(K_MSEC(1000));
    }
}

void task_adv_entry(void *p1, void *p2, void *p3)
{
    k_sleep(K_MSEC(3000));
    printk("[ADV] a tentar modificar chamado_por_adversarial (global do kernel)...\n");

    chamado_por_adversarial = 1;  /* STORE ACCESS FAULT — global em espaco do kernel */

    /* linha abaixo nunca executa */
    void (*fn)(void *, void *, void *) = task_a_entry;
    fn(NULL, NULL, NULL);
    chamado_por_adversarial = 0;
}

K_THREAD_DEFINE(task_a_id,   STACKSIZE, task_a_entry,   NULL, NULL, NULL, PRIORITY, K_USER, 0);
K_THREAD_DEFINE(task_adv_id, STACKSIZE, task_adv_entry, NULL, NULL, NULL, PRIORITY, K_USER, 0);
```

## src/main_z_attack2_stack.c
```c
#include <zephyr/kernel.h>
#include <zephyr/sys/printk.h>
#include <zephyr/app_memory/app_memdomain.h>
#include <zephyr/sys/libc-hooks.h>

/*
 * ATAQUE 2 — ESCRITA NA STACK DE OUTRA TASK (Zephyr)
 *
 * Task A tem uma password local (na sua stack) e escreve o seu endereço em
 * leaked_addr — variável global em shared_part, acessível a ambas as tasks.
 * Task ADV lê o endereço via shared_part e tenta escrever na stack da Task A.
 *
 * RESULTADO ESPERADO:
 *   [MAIN] a configurar dominios...
 *   [MAIN] domA configurado
 *   [MAIN] domB configurado
 *   [MAIN] threads arrancadas
 *   [TASK A] a correr em U-mode
 *   [TASK A] password em stack: 0x8008XXXX
 *   [TASK A] leaked_addr escrito: 0x8008XXXX
 *   [TASK A] password OK: 1234
 *   [ADV] a correr em U-mode, a aguardar 3s...
 *   [ADV] leaked_addr lido: 0x8008XXXX
 *   [ADV] a tentar escrever na stack da Task A...
 *   mcause: 7, Store/AMO access fault   <- PMP bloqueia
 *
 * CONTRASTE COM FREERTOS (M-mode):
 *   FreeRTOS / M-mode → sem PMP activo, a adversarial escreve directamente
 *                        na stack da Task A — password CORROMPIDA.
 *   Zephyr / U-mode   → Store Access Fault (mcause: 7) ao tentar escrever
 *                        na stack de outra task. PMP entry dedicada por thread.
 */

#define STACKSIZE 2048
#define PRIORITY  7

K_APPMEM_PARTITION_DEFINE(shared_part);

/*
 * Dois campos em shared_part — total 8 bytes = minimo NAPOT RISC-V (2^3).
 * Com apenas 4 bytes (um uint32_t) o PMP NAPOT nao consegue criar uma
 * entrada valida e o acesso em U-mode falha.
 */
K_APP_DMEM(shared_part) volatile uint32_t leaked_addr = 0;
K_APP_DMEM(shared_part) volatile uint32_t shared_ready = 0;

static struct k_mem_domain domA;
static struct k_mem_domain domB;

struct k_thread task_a_thread;
K_THREAD_STACK_DEFINE(task_a_stack, STACKSIZE);

struct k_thread task_adv_thread;
K_THREAD_STACK_DEFINE(task_adv_stack, STACKSIZE);

/* ------------------------------------------------------------------ */

void task_a_entry(void *p1, void *p2, void *p3)
{
    printk("[TASK A] a correr em U-mode\n");

    volatile int password = 1234;

    printk("[TASK A] password em stack: 0x%08x\n", (uint32_t)&password);

    leaked_addr = (uint32_t)&password;
    shared_ready = 1;
    printk("[TASK A] leaked_addr escrito: 0x%08x\n", leaked_addr);

    for (;;) {
        if (password == 1234) {
            printk("[TASK A] password OK: %d\n", password);
        } else {
            printk("[TASK A] password CORROMPIDA: 0x%08x  <-- ataque!\n",
                   (uint32_t)password);
        }
        k_sleep(K_MSEC(1000));
    }
}

/* ------------------------------------------------------------------ */

void task_adv_entry(void *p1, void *p2, void *p3)
{
    printk("[ADV] a correr em U-mode, a aguardar leaked_addr...\n");

    /* espera que Task A escreva o endereco via shared_ready */
    while (shared_ready == 0) {
        k_sleep(K_MSEC(100));
    }

    volatile int *ptr = (volatile int *)leaked_addr;

    printk("[ADV] leaked_addr lido: 0x%08x\n", (uint32_t)ptr);
    printk("[ADV] a tentar escrever na stack da Task A...\n");

    /*
     * STORE ACCESS FAULT esperado aqui (mcause: 7):
     * A stack da Task A tem PMP entry exclusiva — Task ADV nao tem acesso.
     * Em FreeRTOS/M-mode esta linha corromperia a password com sucesso.
     */
    *ptr = 0xDEAD;

    printk("[ADV] escrita ok -- proteccao falhou!\n");
}

/* ------------------------------------------------------------------ */

int main(void)
{
    k_tid_t tA, tADV;

    printk("[MAIN] a configurar dominios...\n");

    /*
     * Criar threads suspensas (K_FOREVER) — ainda nao correm.
     * Padrao oficial Zephyr: criar suspensa, configurar dominio, depois start.
     * Garante que o PMP esta pronto antes da primeira instrucao em U-mode.
     */
    tA = k_thread_create(&task_a_thread, task_a_stack, STACKSIZE,
                         task_a_entry, NULL, NULL, NULL,
                         PRIORITY, K_USER, K_FOREVER);

    tADV = k_thread_create(&task_adv_thread, task_adv_stack, STACKSIZE,
                           task_adv_entry, NULL, NULL, NULL,
                           PRIORITY, K_USER, K_FOREVER);

    struct k_mem_partition *parts_a[] = {
#if Z_LIBC_PARTITION_EXISTS
        &z_libc_partition,
#endif
        &shared_part
    };
    struct k_mem_partition *parts_b[] = {
#if Z_LIBC_PARTITION_EXISTS
        &z_libc_partition,
#endif
        &shared_part
    };

    k_mem_domain_init(&domA, ARRAY_SIZE(parts_a), parts_a);
    k_mem_domain_add_thread(&domA, tA);
    printk("[MAIN] domA configurado\n");

    k_mem_domain_init(&domB, ARRAY_SIZE(parts_b), parts_b);
    k_mem_domain_add_thread(&domB, tADV);
    printk("[MAIN] domB configurado\n");

    /* Dominios prontos — so agora arrancar as threads */
    k_thread_start(tA);
    k_thread_start(tADV);

    printk("[MAIN] threads arrancadas\n");
    return 0;
}
```

## src/main_z_attack3_global.c
```c
#include <zephyr/kernel.h>
#include <zephyr/sys/printk.h>

/* FreeRTOS: adversarial escreve directamente em variavel global da TaskA -> TaskA ve "CORROMPIDO"
   Zephyr:   adversarial tenta escrever na variavel global -> Store Access Fault */

#define STACKSIZE 2048
#define PRIORITY  7

volatile int dados_task_a = 42;

void task_a_entry(void *p1, void *p2, void *p3)
{
    for (;;) {
        printk("[TASK A] a correr\n");
        k_sleep(K_MSEC(1000));
    }
}

void task_adv_entry(void *p1, void *p2, void *p3)
{
    k_sleep(K_MSEC(3001));
    printk("[ADV] a tentar corromper dados_task_a \n");

    dados_task_a = 0xDEAD;  /* STORE ACCESS FAULT — global em espaco do kernel */

    printk("[ADV] dados corrompidos!\n");  /* nunca executa */
}

K_THREAD_DEFINE(task_a_id,   STACKSIZE, task_a_entry,   NULL, NULL, NULL, PRIORITY, K_USER, 0);
K_THREAD_DEFINE(task_adv_id, STACKSIZE, task_adv_entry, NULL, NULL, NULL, 6, K_USER, 0);
```

## src/main_z_attack4_tcb.c
```c
#include <zephyr/kernel.h>
#include <zephyr/sys/printk.h>

/* FreeRTOS: adversarial corrompe o primeiro campo do TCB (stack pointer) da TaskA -> crash
   Zephyr:   adversarial tenta escrever no struct k_thread da task_a_id -> Store Access Fault */

#define STACKSIZE 2048
#define PRIORITY  7

/* referencia interna criada pelo K_THREAD_DEFINE(task_a_id, ...) abaixo */
extern struct k_thread _k_thread_obj_task_a_id;

void task_a_entry(void *p1, void *p2, void *p3)
{
    for (;;) {
        printk("[TASK A] a correr normalmente\n");
        k_sleep(K_MSEC(1000));
    }
}

void task_adv_entry(void *p1, void *p2, void *p3)
{
    k_sleep(K_MSEC(3000));

    volatile uint32_t *tcb = (volatile uint32_t *)&_k_thread_obj_task_a_id;
    printk("[ADV] TCB de Task A em: 0x%08x\n", (uint32_t)tcb);
    printk("[ADV] a tentar corromper stack pointer da Task A...\n");

    tcb[0] = 0xDEADBEEF;  /* STORE ACCESS FAULT — struct k_thread em espaco do kernel */

    printk("[ADV] stack pointer corrompido!\n");  /* nunca executa */
}

K_THREAD_DEFINE(task_a_id,   STACKSIZE, task_a_entry,   NULL, NULL, NULL, PRIORITY, K_USER, 0);
K_THREAD_DEFINE(task_adv_id, STACKSIZE, task_adv_entry, NULL, NULL, NULL, PRIORITY, K_USER, 0);
```

## src/main_z_bug_acidental.c
```c
#include <zephyr/kernel.h>
#include <zephyr/sys/printk.h>

/*
 * BUG ACIDENTAL — ESCRITA FORA DOS LIMITES (Zephyr)
 *
 * Equivalente ao freertos_demo6_bug_acidental.c.
 *
 * CENÁRIO: Task Buggy tem um array local de 8 bytes mas por engano
 * itera 512 vezes (erro de constante — bug clássico em C embebido).
 * Não é malware — é um programador que escreveu o número errado.
 *
 * RESULTADO ESPERADO (Zephyr / U-mode):
 *   [TASK A] a correr normalmente
 *   [TASK A] a correr normalmente
 *   [BUG]    a escrever config (bug: 512 iteracoes, devia ser 8)...
 *   mcause: 7, Store Access Fault   <- PMP contém o bug dentro da Task Buggy
 *   [TASK A] a correr normalmente   <- Task A não é afectada, continua a correr
 *   ...
 *
 * CONTRASTE COM FREERTOS (freertos_demo6_bug_acidental.c):
 *   FreeRTOS / M-mode → overflow silencioso, dados da Task A corrompidos,
 *                        nenhuma detecção, sistema continua a correr com
 *                        dados errados.
 *   Zephyr / U-mode   → Store Access Fault contém a falha na Task Buggy.
 *                        Task A não é afectada.
 *
 * NOTA: O isolamento aqui não é contra um adversário — é contra um bug.
 * Mostra que PMP/U-mode protege a integridade do sistema mesmo sem
 * intenção maliciosa: uma task com erro não consegue destruir as outras.
 */

#define STACKSIZE 2048
#define PRIORITY  7

void task_a_entry(void *p1, void *p2, void *p3)
{
    for (;;) {
        printk("[TASK A] a correr normalmente\n");
        k_sleep(K_MSEC(1000));
    }
}

void task_buggy_entry(void *p1, void *p2, void *p3)
{
    k_sleep(K_MSEC(3000));

    printk("[BUG] a escrever config (bug: 512 iteracoes, devia ser 8)...\n");

    volatile char config[8];

    /* BUG: programador escreveu 512 em vez de 8 — erro de constante */
    for (volatile int i = 0; i < 512; i++) {
        config[i] = 0;  /* Store Access Fault quando ultrapassa a região PMP da stack */
    }

    printk("[BUG] escrita concluida\n");  /* nunca executa */
}

K_THREAD_DEFINE(task_a_id,     STACKSIZE, task_a_entry,     NULL, NULL, NULL, PRIORITY, K_USER, 0);
K_THREAD_DEFINE(task_buggy_id, STACKSIZE, task_buggy_entry, NULL, NULL, NULL, PRIORITY, K_USER, 0);
```

## src/main_z_test_nop.c
```c
#include <zephyr/kernel.h>
#include <zephyr/sys/printk.h>

#define STACKSIZE 2048
#define PRIORITY  7

void task_test_entry(void *p1, void *p2, void *p3)
{
    k_sleep(K_MSEC(2000));
    printk("[TEST] sw com 2 NOPs antes + segundo sw a seguir\n");
    printk("[TEST] sem RAW hazard, scoreboard quase vazio\n");

    /*
     * lui  t1      <- carrega endereco
     * nop          <- quebra RAW: t1 disponivel antes do sw chegar ao EX
     * nop          <- idem
     * sw zero,0(t1) <- store que falha (mepc aqui)
     * sw zero,0(t1) <- segundo store imediatamente a seguir
     *
     * Theory 1 (scoreboard): mcause=7, segundo sw chega à store_unit em N+1
     * Theory 2 (RAW hazard): mcause=5, sem RAW -> st_ready=1 -> VALID_STORE -> req=0
     */
    __asm__ volatile(
        "lui  t1, 0x80011\n"
        "nop\n"
        "nop\n"
        "sw   zero, 0(t1)\n"
        "sw   zero, 0(t1)\n"
        ::: "t1"
    );

    printk("[TEST] sem fault -- nao devia chegar aqui\n");
}

K_THREAD_DEFINE(task_test_id, STACKSIZE, task_test_entry,
                NULL, NULL, NULL, PRIORITY, K_USER, 0);
```

## src/main_z_test_stores.c
```c
#include <zephyr/kernel.h>
#include <zephyr/sys/printk.h>

#define STACKSIZE 2048
#define PRIORITY  7

void task_a_entry(void *p1, void *p2, void *p3)
{
    for (;;) {
        printk("[TASK A] A correr normalmente...\n");
        k_sleep(K_MSEC(1000));
    }
}

void task_adv_entry(void *p1, void *p2, void *p3)
{
    k_sleep(K_MSEC(3000));
    printk("[TESTE 5 STORES] A disparar sequencia de escrita para forcar mcause = 7...\n");

    /*
     * t1: Endereço protegido do kernel
     * Executa 5 instruções sw seguidas no mesmo endereço protegido.
     * Se o hardware roubar o tipo da instrução seguinte, vai apanhar um sw
     * e terá de registar Store Access Fault (mcause = 7).
     */
    __asm__ volatile (
        "li t1, 0x80011000\n\t"

        "sw zero, 0(t1)\n\t"      /* 1º Store -> Onde o PMP vai disparar */
        "sw zero, 0(t1)\n\t"      /* 2º Store */

    );

    printk("[TESTE 5 STORES] Se leres isto, a proteccao falhou.\n");
}

K_THREAD_DEFINE(task_a_id,   STACKSIZE, task_a_entry,   NULL, NULL, NULL, PRIORITY, K_USER, 0);
K_THREAD_DEFINE(task_adv_id, STACKSIZE, task_adv_entry, NULL, NULL, NULL, PRIORITY, K_USER, 0);
```

## src/main_z_teste_false_store.c
```c
//
// Created by mendes on 16/05/26.
//

#include <zephyr/kernel.h>
#include <zephyr/sys/printk.h>

#define STACKSIZE 2048
#define PRIORITY  7

void task_a_entry(void *p1, void *p2, void *p3)
{
    for (;;) {
        printk("[TASK A] A correr normalmente...\n");
        k_sleep(K_MSEC(1000));
    }
}

void task_adv_entry(void *p1, void *p2, void *p3)
{
    k_sleep(K_MSEC(3000));
    printk("[TESTE ILEGAL] A disparar Stores em multiplos enderecos proibidos...\n");

    /*
     * Todos estes endereços pertencem ao espaço do kernel (z_interrupt_stacks).
     * São todos 100% ILEGAIS para a Task ADV em U-mode, mas são números diferentes.
     */
    __asm__ volatile (
        "li t1, 0x80011000\n\t"   /* 1º Alvo proibido */
        "li t2, 0x80011004\n\t"   /* 2º Alvo proibido */

        "sw zero, 0(t1)\n\t"      /* 1º Store -> Bate no PMP (mepc deve ser o endereço desta instrução) */
        "sw zero, 0(t2)\n\t"      /* 2º Store -> Instrução mepc + 4 */
    );

    printk("[TESTE ILEGAL] Se leres isto, a proteccao falhou.\n");
}

K_THREAD_DEFINE(task_a_id,   STACKSIZE, task_a_entry,   NULL, NULL, NULL, PRIORITY, K_USER, 0);
K_THREAD_DEFINE(task_adv_id, STACKSIZE, task_adv_entry, NULL, NULL, NULL, PRIORITY, K_USER, 0);
```

## src/test_lw_no_entry.c
```c
#include <zephyr/kernel.h>
#include <zephyr/sys/printk.h>

/*
 * TESTE 1 — LW de regiao sem entrada PMP (default deny)
 *
 * A thread em U-mode faz um load explícito de um global do kernel.
 * Esse endereço não tem nenhuma entrada PMP para U-mode.
 * ESPERADO: mcause=5 (Load access fault) — baseline de confirmação.
 */

#define STACKSIZE 2048
#define PRIORITY  7

static volatile int kernel_var = 0xABCD1234;

void test_thread(void *p1, void *p2, void *p3)
{
    k_sleep(K_MSEC(500));

    uintptr_t addr = (uintptr_t)&kernel_var;
    volatile int resultado;

    printk("[TESTE 1] LW de kernel_var @ 0x%08x (sem entrada PMP)...\n", (uint32_t)addr);

    __asm__ volatile("lw %0, 0(%1)" : "=r"(resultado) : "r"(addr) : "memory");

    printk("[TESTE 1] resultado: 0x%08x  <-- nao devia chegar aqui\n", resultado);
}

K_THREAD_DEFINE(test_id, STACKSIZE, test_thread, NULL, NULL, NULL, PRIORITY, K_USER, 0);
```

## src/test_sw_has_entry.c
```c
#include <zephyr/kernel.h>
#include <zephyr/sys/printk.h>

/*
 * TESTE 3 — SW para regiao COM entrada PMP (R|X, sem W)
 *
 * A thread em U-mode faz um store explícito para um endereço do .text
 * (codigo do kernel). Essa região TEM uma entrada PMP activa com R|X,
 * mas SEM W — é um "match com permissão errada".
 *
 * Distingue dois paths no CVA6:
 *   - Path A (sem match):  nenhuma entrada cobre o addr → allow_o=0
 *   - Path B (match+deny): entrada cobre mas W=0       → allow_o=0
 *
 * ESPERADO: mcause=7 (Store/AMO access fault) — ambos os paths devem dar 7.
 * SE TESTE 2 deu 5 e TESTE 3 der 7 → o bug está no path "sem match".
 * SE AMBOS derem 5 (lsu_is_store_i não chega
 * ao pmp_data_if ou é ignorado).
 */

#define STACKSIZE 2048
#define PRIORITY  7

/* Ponteiro para uma função do kernel — endereço em .text, coberto por PMP R|X */
extern void z_riscv_fault(void);

void test_thread(void *p1, void *p2, void *p3)
{
    k_sleep(K_MSEC(500));

    uintptr_t addr = (uintptr_t)z_riscv_fault;
    int valor = 0xDEAD;

    printk("[TESTE 3] SW para .text @ 0x%08x (entrada PMP R|X, sem W)...\n", (uint32_t)addr);

    __asm__ volatile("sw %0, 0(%1)" : : "r"(valor), "r"(addr) : "memory");

    printk("[TESTE 3] store ok  <-- nao devia chegar aqui\n");
}

K_THREAD_DEFINE(test_id, STACKSIZE, test_thread, NULL, NULL, NULL, PRIORITY, K_USER, 0);
```

## src/test_sw_no_entry.c
```c
#include <zephyr/kernel.h>
#include <zephyr/sys/printk.h>

/*
 * TESTE 2 — SW para regiao sem entrada PMP (default deny)
 *
 * A thread em U-mode faz um store explícito para um global do kernel.
 * Esse endereço não tem nenhuma entrada PMP para U-mode.
 * ESPERADO: mcause=7 (Store/AMO access fault)
 * SE VIER 5 (Load access fault) → o CVA6 está a reportar errado no path
 * "sem entrada" — confirma o bug independente do tipo de acesso.
 */

#define STACKSIZE 2048
#define PRIORITY  7

static volatile int kernel_var = 0;

void test_thread(void *p1, void *p2, void *p3)
{
    k_sleep(K_MSEC(500));

    uintptr_t addr = (uintptr_t)&kernel_var;
    int valor = 0xDEAD;

    printk("[TESTE 2] SW para kernel_var @ 0x%08x (sem entrada PMP)...\n", (uint32_t)addr);

    __asm__ volatile("sw %0, 0(%1)" : : "r"(valor), "r"(addr) : "memory");

    printk("[TESTE 2] store ok  <-- nao devia chegar aqui\n");
}

K_THREAD_DEFINE(test_id, STACKSIZE, test_thread, NULL, NULL, NULL, PRIORITY, K_USER, 0);
```
