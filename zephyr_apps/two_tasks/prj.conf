## CMakeLists.txt
```
cmake_minimum_required(VERSION 3.20.0)
find_package(Zephyr REQUIRED HINTS $ENV{ZEPHYR_BASE})
project(two_tasks)
target_sources(app PRIVATE src/main.c)
```

## prj.conf
```kconfig
CONFIG_USERSPACE=y

CONFIG_PRINTK=y
# MTIME no CVA6 APU corre ao ritmo do RTC (32768 Hz), nao do CPU clock
CONFIG_SYS_CLOCK_HW_CYCLES_PER_SEC=32768
CONFIG_SYS_CLOCK_TICKS_PER_SEC=1000
# CVA6 TOR+Lock bloqueia M-mode reads mesmo com R bit activo -- remover L da ROM
CONFIG_PMP_UNLOCK_ROM_FOR_DEBUG=y
```

## src/main.c
```c
#include <zephyr/kernel.h>
#include <zephyr/sys/printk.h>

#define STACKSIZE 2048
#define PRIORITY  7

static void print_privilege_mode(const char *task_name)
{
	uint32_t mstatus;
	__asm__ volatile ("csrr %0, mstatus" : "=r"(mstatus));
	uint32_t mpp = (mstatus >> 11) & 0x3;
	const char *mode = (mpp == 3) ? "M-mode" : (mpp == 1) ? "S-mode" : "U-mode";
	printk("%s [CSR] MPP=%d (%s) mstatus=0x%08x\n", task_name, mpp, mode, mstatus);
}

static void task_a(void *p1, void *p2, void *p3)
{
	while (1) {
		print_privilege_mode("[TASK A]");
		printk("[TASK A] a correr\n\n");
		k_sleep(K_MSEC(2000));
	}
}

static void task_b(void *p1, void *p2, void *p3)
{
	while (1) {
		print_privilege_mode("[TASK B]");
		printk("[TASK B] a correr\n\n");
		k_sleep(K_MSEC(5000));
	}
}

K_THREAD_DEFINE(task_a_id, STACKSIZE, task_a, NULL, NULL, NULL, PRIORITY, K_USER, 0);
K_THREAD_DEFINE(task_b_id, STACKSIZE, task_b, NULL, NULL, NULL, PRIORITY, K_USER, 0);
```

## src/main_userspace.c
```c
#include <zephyr/kernel.h>
#include <zephyr/sys/printk.h>

#define STACKSIZE 2048
#define PRIORITY  7

static void check_mode(const char *task_name)
{
	if (k_is_user_context()) {
		printk("%s [API] USER MODE (nao privilegiado)\n", task_name);
	} else {
		printk("%s [API] KERNEL MODE (privilegiado)\n", task_name);
	}
}

void task_a_entry(void *p1, void *p2, void *p3)
{
	while (1) {
		check_mode("[TASK A]");
		printk("[TASK A] a correr\n\n");
		k_sleep(K_MSEC(2000));
	}
}

void task_b_entry(void *p1, void *p2, void *p3)
{
	while (1) {
		check_mode("[TASK B]");
		printk("[TASK B] a correr\n\n");
		k_sleep(K_MSEC(5000));
	}
}

K_THREAD_DEFINE(task_a_id, STACKSIZE, task_a_entry, NULL, NULL, NULL, PRIORITY, K_USER, 0);
K_THREAD_DEFINE(task_b_id, STACKSIZE, task_b_entry, NULL, NULL, NULL, PRIORITY, K_USER, 0);
```
